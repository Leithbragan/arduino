#include <ros.h>
#include <std_msgs/String.h>
#include <LiquidCrystal.h>

ros::NodeHandle nh;
char ch[1];

void messageCb( const std_msgs::String& toggle_msg){
   ch[0] = toggle_msg.data[0];  
}

ros::Subscriber<std_msgs::String> sub("signal", &messageCb );
LiquidCrystal lcd(8, 9, 4, 5, 6, 7);
byte sim[8] = {
  B00000,
  B00000,
  B00100,
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  B00000,
};
int p1;
int p2;
int min_v_l;
int max_v_l;

void setup() {
  
  lcd.begin(16, 2);
  lcd.clear();
  lcd.createChar(0, sim);
  analogWrite(10, 30);
  lcd.setCursor(8, 1);
  lcd.write(byte(0));
  nh.initNode();
  nh.subscribe(sub);
  p1 = 8;
  p2 = 1;
  min_v_l = 0;
  max_v_l = 15;
}


void printer(int p_1 , int p_2) {
  lcd.clear();
  lcd.setCursor(p_1, p_2);
  lcd.write(byte(0));
}

void loop() {
  if (ch[0] == 'w') {
    if (p2 == 1) {
      p2 = p2 - 1;
      printer(p1, p2);
    } else {
      p2 = p2 + 1;
      printer(p1, p2);
    }
  } else if (ch[0] == 'a') {
    if (p1 == min_v_l) {
      p1 = max_v_l;
      printer(p1, p2);
    } else if (p1 == max_v_l) {
      p1 = max_v_l - 1;
      printer(p1, p2);
    } else {
      p1 = p1 - 1;
      printer(p1, p2);
    }
  } else if (ch[0] == 'd') {
    if (p1 == max_v_l) {
      p1 = min_v_l;
      printer(p1, p2);

    } else if (p1 != max_v_l) {
      p1 = p1 + 1;
      printer(p1, p2);
    }
  } else if (ch[0] == 's') {
    if (p1 == 2) {
      p2 = p2 + 1;
      printer(p1, p2);
    } else {
      p2 = p2 - 1;
      printer(p1, p2);
    }
  }
  delay(1000);
  nh.spinOnce();
 
}
